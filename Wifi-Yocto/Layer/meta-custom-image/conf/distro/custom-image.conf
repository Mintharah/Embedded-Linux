## Wifi-Yocto/Layer/meta-custom-image/conf/distro/custom-image.conf
```bitbake
require conf/distro/poky.conf

DISTRO = "custom-image"
DISTRO_NAME = "Custom Image (ITI Project Reference Distro)"

MAINTAINER = "Yasmine <yasmine@lists.yoctoproject.org>"

DISTRO_FEATURES:append = " systemd usrmerge wifi"
DISTRO_FEATURES_BACKFILL:append = " sysvinit"
VIRTUAL-RUNTIME_init_manager = "systemd"

CMDLINE:append = " console=ttyAMA1,115200"
```

## Yocto-Splash-Gui/meta-custom-image/conf/distro/custom-image.conf
```bitbake
require conf/distro/poky.conf

DISTRO = "custom-image"
DISTRO_NAME = "Custom Image (ITI Project Reference Distro)"

MAINTAINER = "Yasmine <yasmine@lists.yoctoproject.org>"

DISTRO_FEATURES:append = " systemd usrmerge wifi wayland opengl pam"
DISTRO_FEATURES_BACKFILL:append = " sysvinit"
VIRTUAL-RUNTIME_init_manager = "systemd"

CMDLINE:append = " console=ttyAMA1,115200"

PACKAGECONFIG:append:pn-qtbase = " wayland"

APPEND = "quiet splash logo.nologo vt.global_cursor_default=0"

RPI_EXTRA_CONFIG = "\ndtoverlay=vc4-fkms-v3d\ngpu_mem=128\n"
```

## yocto-task-1/meta-task-one/conf/layer.conf
```bitbake
BBPATH .= ":${LAYERDIR}"

BBFILES += "${LAYERDIR}/recipes-*/*/*.bb \
            ${LAYERDIR}/recipes-*/*/*.bbappend"

BBFILE_COLLECTIONS += "meta-task-one"
BBFILE_PATTERN_meta-task-one := "^${LAYERDIR}/"
BBFILE_PRIORITY_meta-task-one = "6"

LAYERDEPENDS_meta-task-one = "core"
LAYERSERIES_COMPAT_meta-task-one = "scarthgap"
```
